## Kconfig
```kconfig
config SETUP_MODE
    bool "Setup mode: LED indicators, BLE profile keys, battery display, sleep sequence"
    depends on ZMK_BLE
    default n

if SETUP_MODE

config SETUP_MODE_PROFILE_LEDS
    bool "Profile LEDs LED_0..LED_3 (needs the swanboard_led shield)"
    default n
    help
      On: boot / profile / battery / setup / sleep animations on 4 LEDs.
      Off: those are left to the display (nice!view).

config SETUP_MODE_SOFT_OFF
    bool "Use soft off instead of deep sleep (setup-mode sleep key and idle timeout)"
    default n
    help
      Off (default): the setup-mode sleep key and the idle timeout both use ZMK's deep
      sleep (needs CONFIG_ZMK_SLEEP=y and CONFIG_ZMK_IDLE_SLEEP_TIMEOUT).
      On: both use soft off instead (needs CONFIG_ZMK_PM_SOFT_OFF=y; set
      CONFIG_ZMK_SLEEP=n so ZMK's own deep sleep timer does not interfere).
      After a soft off nothing wakes the keyboard except the reset button.
      The idle soft off can be disabled with CONFIG_SETUP_MODE_SOFT_OFF_TIMEOUT_MS=0
      (use it together with CONFIG_ZMK_SLEEP=y: idle -> deep sleep, sleep key -> soft off).

config SETUP_MODE_SOFT_OFF_TIMEOUT_MS
    int "Idle time before soft off (ms, 0 = no idle soft off)"
    depends on SETUP_MODE_SOFT_OFF
    default 600000

endif # SETUP_MODE

config SWANBOARD_DISPLAY_TWEAKS
    bool "nice!view tweaks on top of the built-in status screen (rotation, BLE symbol)"
    depends on ZMK_DISPLAY
    default n

if SWANBOARD_DISPLAY_TWEAKS

config SWANBOARD_DISPLAY_ROTATE_180
    bool "Rotate the display picture by 180 degrees (LVGL software rotation)"
    default n

config SWANBOARD_DISPLAY_BLE_SYMBOL
    bool "Show the Bluetooth symbol instead of the Wi-Fi symbol for BLE"
    default n

config SWANBOARD_DISPLAY_LAYER_SYMBOL
    bool "Show other symbols in front of some layer names (settings / power)"
    default n

endif # SWANBOARD_DISPLAY_TWEAKS

config SWANBOARD_BATTERY_LINEAR
    bool "Battery sensor wrapper with a linear voltage -> % mapping (CR2032, LIR2032)"
    depends on SENSOR
    default n

config SWANBOARD_STARTUP_BEEP
    bool "Play a short melody on a piezo buzzer at boot / wake (needs the swanboard_buzzer shield)"
    default n
```

## boards/shields/swanboard/Kconfig.defconfig
```kconfig
if SHIELD_SWANBOARD

config ZMK_KEYBOARD_NAME
    default "swanboard"

endif # SHIELD_SWANBOARD
```

## boards/shields/swanboard_buzzer/Kconfig.shield
```kconfig
config SHIELD_SWANBOARD_BUZZER
    def_bool $(shields_list_contains,swanboard_buzzer)
```

## boards/shields/swanboard_cr2032/Kconfig.shield
```kconfig
config SHIELD_SWANBOARD_CR2032
    def_bool $(shields_list_contains,swanboard_cr2032)
```

## boards/shields/swanboard_lir2032/Kconfig.shield
```kconfig
config SHIELD_SWANBOARD_LIR2032
    def_bool $(shields_list_contains,swanboard_lir2032)
```

## dts/bindings/behaviors/zmk,behavior-setup-mode.yaml
```yaml
description: Setup mode behavior (setup layer, sleep sequence) + low battery LED + optional profile LEDs

compatible: "zmk,behavior-setup-mode"

include: one_param.yaml

properties:
  lowbat-gpios:
    type: phandle-array
    required: true
    description: Low battery LED (1 entry)

  profile-led-gpios:
    type: phandle-array
    required: false
    description: Profile LEDs LED_0..LED_3 (4 entries), added by the swanboard_led shield
```

## dts/bindings/misc/swanboard,startup-beep.yaml
```yaml
description: Piezo buzzer that plays a short melody at boot / wake (see src/startup_beep.c)

compatible: "swanboard,startup-beep"

include: base.yaml

properties:
  buzzer-gpios:
    type: phandle-array
    required: true
    description: GPIO that drives the buzzer (square wave, one entry)
```

## dts/bindings/sensor/swanboard,battery-linear.yaml
```yaml
description: |
  Battery "wrapper" sensor with a linear voltage -> % mapping (CR2032, LIR2032, ...).
  It reads the battery voltage from another ZMK battery sensor (e.g. the nRF VDDH one)
  and reports its own state of charge, mapped linearly between empty-mv (0 %) and
  full-mv (100 %).

compatible: "swanboard,battery-linear"

include: base.yaml

properties:
  source:
    type: phandle
    required: true
    description: Battery sensor that provides the voltage (SENSOR_CHAN_GAUGE_VOLTAGE)

  full-mv:
    type: int
    default: 3200
    description: Voltage in mV that is shown as 100 %

  empty-mv:
    type: int
    default: 2700
    description: Voltage in mV that is shown as 0 %

  offset-mv:
    type: int
    default: 0
    description: |
      Calibration: this many mV are added to the measured voltage before it is mapped
      (e.g. to compensate a diode drop or the load sag between the battery and the
      measuring point). Can be negative.
```

## dts/bindings/sensor/twelvepad,battery-cr2032.yaml
```yaml
description: |
  Battery "wrapper" sensor for a CR2032 coin cell. It reads the battery voltage from
  another ZMK battery sensor (e.g. the nRF VDDH one) and reports its own state of
  charge, mapped linearly between empty-mv (0 %) and full-mv (100 %).

compatible: "twelvepad,battery-cr2032"

include: base.yaml

properties:
  source:
    type: phandle
    required: true
    description: Battery sensor that provides the voltage (SENSOR_CHAN_GAUGE_VOLTAGE)

  full-mv:
    type: int
    default: 3200
    description: Voltage in mV that is shown as 100 %

  empty-mv:
    type: int
    default: 2700
    description: Voltage in mV that is shown as 0 %

  offset-mv:
    type: int
    default: 0
    description: |
      Calibration: this many mV are added to the measured voltage before it is mapped
      (e.g. to compensate a diode drop or the load sag between the battery and the
      measuring point). Can be negative.
```
