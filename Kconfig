## Kconfig
```kconfig
config SETUP_MODE
    bool "Setup mode: LED indicators, BLE profile keys, battery display, sleep sequence"
    depends on ZMK_BLE
    default n

if SETUP_MODE

config SETUP_MODE_SOFT_OFF
    bool "Use soft off instead of deep sleep (setup-mode sleep key and idle timeout)"
    default n
    help
      Off (default): the setup-mode sleep key and the idle timeout both use ZMK's deep
      sleep (needs CONFIG_ZMK_SLEEP=y and CONFIG_ZMK_IDLE_SLEEP_TIMEOUT).
      On: both use soft off instead (needs CONFIG_ZMK_PM_SOFT_OFF=y; set
      CONFIG_ZMK_SLEEP=n so ZMK's own deep sleep timer does not interfere).
      After a soft off nothing wakes the keyboard except the reset button.
      The idle soft off can be disabled with CONFIG_SETUP_MODE_SOFT_OFF_TIMEOUT_MS=0
      (use it together with CONFIG_ZMK_SLEEP=y: idle -> deep sleep, sleep key -> soft off).

config SETUP_MODE_SOFT_OFF_TIMEOUT_MS
    int "Idle time before soft off (ms, 0 = no idle soft off)"
    depends on SETUP_MODE_SOFT_OFF
    default 600000

endif # SETUP_MODE

config TWELVEPAD_DISPLAY_TWEAKS
    bool "nice!view tweaks on top of the built-in status screen (rotation, BLE symbol)"
    depends on ZMK_DISPLAY
    default n

if TWELVEPAD_DISPLAY_TWEAKS

config TWELVEPAD_DISPLAY_ROTATE_180
    bool "Rotate the display picture by 180 degrees (LVGL software rotation)"
    default n

config TWELVEPAD_DISPLAY_BLE_SYMBOL
    bool "Show the Bluetooth symbol instead of the Wi-Fi symbol for BLE"
    default n

endif # TWELVEPAD_DISPLAY_TWEAKS
```

## boards/shields/twelvepad/Kconfig.defconfig
```kconfig
if SHIELD_TWELVEPAD

config ZMK_KEYBOARD_NAME
    default "twelvepad"

endif # SHIELD_TWELVEPAD
```

## dts/bindings/behaviors/zmk,behavior-led-indicator.yaml
```yaml
description: LED indicator behavior (BLE profile / battery display and animations)

compatible: "zmk,behavior-led-indicator"

include: one_param.yaml

properties:
  led-gpios:
    type: phandle-array
    required: true
```

## dts/bindings/behaviors/zmk,behavior-setup-mode.yaml
```yaml
description: Setup mode behavior (setup layer, sleep sequence) + low battery LED

compatible: "zmk,behavior-setup-mode"

include: one_param.yaml

properties:
  lowbat-gpios:
    type: phandle-array
    required: true
```
